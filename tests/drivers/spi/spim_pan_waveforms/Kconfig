## tests/drivers/spi/spim_pan_waveforms/Kconfig
```kconfig
#
# Copyright (c) 2026 Nordic Semiconductor ASA
#
# SPDX-License-Identifier: LicenseRef-Nordic-5-Clause
#

config SPIM_WORKAROUND_FORCE_OFF
	bool "Force disable workaround"
	default n
	help
	  When enabled, the workaround for the SPIM PAN issue will be disabled.

source "Kconfig.zephyr"
```

## tests/drivers/spi/spim_pan_waveforms/sample.yaml
```yaml
sample:
  name: SPIM workaround waveforms
tests:
  drivers.spim_pan_waveforms:
    platform_allow:
      - nrf54l15dk/nrf54l15/cpuapp
      - nrf54h20dk/nrf54h20/cpuapp
  drivers.spim_pan_waveforms.no_workaround:
    platform_allow:
      - nrf54l15dk/nrf54l15/cpuapp
      - nrf54h20dk/nrf54h20/cpuapp
    extra_args:
      - -DCONFIG_SPIM_WORKAROUND_FORCE_OFF=y
```
